## NhanhB-DeviceDetect-cleanup/firmware/sniffer/main/Kconfig.projbuild
```kconfig
menu "WiFi research sniffer"
config PROBE_COUNTRY
    string "Country code (e.g. VN; local channel policy)"
    default "VN"

choice SNIFFER_MODE
    prompt "Capture mode"
    default PROBE_BASELINE

config PROBE_BASELINE
    bool "Probe Request baseline (JSONL v1)"

config DEVICE_ACTIVITY_FIXED_CHANNEL
    bool "DEVICE_ACTIVITY_FIXED_CHANNEL (JSONL v2)"

endchoice

if DEVICE_ACTIVITY_FIXED_CHANNEL
config DEVICE_ACTIVITY_CHANNEL
    int "Fixed router primary channel"
    range 1 13
    default 6
    help
        Set the router's 2.4 GHz primary channel. Startup checks the selected
        country's permitted channel range. Used when no valid NVS settings exist.

config DEVICE_ACTIVITY_REGISTERED_MACS
    string "Registered MACs (comma-separated, no spaces, up to 16)"
    default ""
    help
        Enter the consented devices' Wi-Fi MAC addresses for this network.
        An empty list enables channel counters only. Used only as the fallback before runtime configuration is saved.
endif

if PROBE_BASELINE
config PROBE_HOPPING
    bool "Hop channels (otherwise fixed channel)"
    default y
config PROBE_LAST_CHANNEL
    int "Last channel (configure for local country policy)"
    range 1 13
    default 13
config PROBE_FIXED_CHANNEL
    int "Fixed / first channel"
    range 1 11
    default 6
config PROBE_DWELL_MS
    int "Channel dwell milliseconds"
    range 100 10000
    default 3000
endif
endmenu
```

## firmware/rx/main/Kconfig.projbuild
```kconfig
menu "PBL3 CSI"
    config CSI_TEN_BOARD
        string "Ten board in trong BOOT/STAT (RX1, RX2, RX3)"
        default "RX1"
    config CSI_KENH
        int "Kenh Wi-Fi 2,4 GHz (giong TX)"
        range 1 13
        default 6
    config CSI_MAC_TX
        string "MAC cua TX can loc (giong CSI_MAC_TX ben TX)"
        default "1a:00:00:00:00:00"
endmenu
```

## firmware/tx/main/Kconfig.projbuild
```kconfig
menu "PBL3 CSI"
    config CSI_KENH
        int "Kenh Wi-Fi 2,4 GHz (TX va moi RX phai giong nhau)"
        range 1 13
        default 6
    config CSI_MAC_TX
        string "MAC phat ESP-NOW cua TX (aa:bb:cc:dd:ee:ff, bit 1 cua byte dau = 1)"
        default "1a:00:00:00:00:00"
    config CSI_TAN_SO
        int "So goi ESP-NOW moi giay"
        range 10 1000
        default 100
endmenu
```
